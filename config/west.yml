## config/west.yml
```yaml
# west.yml (placed in repo root)
manifest:
  projects:
    - name: zmk
      url: https://github.com/zmkfirmware/zmk
      revision: main
      path: zmk
  self:
    path: .
```
